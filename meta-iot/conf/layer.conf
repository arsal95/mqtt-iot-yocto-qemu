## meta-iot/conf/layer.conf
```bitbake
# Minimal Yocto layer configuration for meta-iot

LCONF_VERSION = "7"

BBPATH .= ":${LAYERDIR}"
BBFILES += "${LAYERDIR}/recipes-*/*/*.bb \
           ${LAYERDIR}/recipes-*/*/*.bbappend"

BBFILE_COLLECTIONS ?= "meta-iot"
BBFILE_PATTERN_meta-iot := "^${LAYERDIR}/"
BBFILE_PRIORITY_meta-iot := "6"
LAYERVERSION_meta-iot = "1"
```
